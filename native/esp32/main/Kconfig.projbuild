## native/esp32/main/Kconfig.projbuild
```kconfig
menu "RuVi research inference"
config RUVI_CONTEXT
    int "Workspace context capacity"
    range 8 512
    default 128
config RUVI_MAX_NEW
    int "Maximum generated tokens"
    range 1 128
    default 16
config RUVI_PROMPT
    string "Comma-separated prefix token IDs (including language tag and separator)"
    default "4,2441,3938,18,421,2507,337,37,3"

choice RUVI_BACKEND
    prompt "Inference execution backend"
    default RUVI_BACKEND_S3
    help
        Select inference execution backend.

config RUVI_BACKEND_SCALAR
    bool "Scalar CPU reference"

config RUVI_BACKEND_TILED
    bool "Portable tiled kernel"

config RUVI_BACKEND_S3
    bool "ESP32-S3 128-bit EE SIMD accelerated"
endchoice

config RUVI_CORES
    int "Number of CPU cores"
    range 1 2
    default 2

config RUVI_MODEL_IN_PSRAM
    bool "Load model weights into PSRAM at startup"
    default y
    help
        Copies the model blob from Flash into Octal PSRAM at startup.
        Eliminates Flash Cache thrashing and accelerates inference.

config RUVI_TILE_ROWS
    int "Weight tile rows (8, 16, or 32)"
    range 8 32
    default 16

config RUVI_MICROBATCH
    int "Prefill microbatch size"
    range 1 64
    default 16
endmenu
```

## native/esp32/sdkconfig.defaults
```kconfig
CONFIG_IDF_TARGET="esp32s3"
CONFIG_ESPTOOLPY_FLASHSIZE_16MB=y
CONFIG_ESPTOOLPY_FLASHMODE_QIO=y
CONFIG_ESPTOOLPY_FLASHFREQ_80M=y
CONFIG_SPIRAM=y
CONFIG_SPIRAM_MODE_OCT=y
CONFIG_SPIRAM_SPEED_80M=y
CONFIG_SPIRAM_USE_MALLOC=y
CONFIG_SPIRAM_MALLOC_ALWAYSINTERNAL=4096
CONFIG_SPIRAM_MALLOC_RESERVE_INTERNAL=32768
CONFIG_PARTITION_TABLE_CUSTOM=y
CONFIG_PARTITION_TABLE_CUSTOM_FILENAME="partitions.csv"
CONFIG_ESP_MAIN_TASK_STACK_SIZE=8192
# A research inference can take minutes; the main task must not trip TWDT.
# CONFIG_ESP_TASK_WDT_INIT is not set
CONFIG_COMPILER_OPTIMIZATION_PERF=y
CONFIG_ESP_DEFAULT_CPU_FREQ_MHZ_240=y
CONFIG_RUVI_CORES=2
CONFIG_RUVI_MODEL_IN_PSRAM=y
CONFIG_RUVI_CONTEXT=128
CONFIG_RUVI_MAX_NEW=16
CONFIG_RUVI_PROMPT="4,2441,3938,18,421,2507,337,37,3"
```
